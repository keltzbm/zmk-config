/*
 * Copyright (c) 2020 Pete Johanson
 *
 * SPDX-License-Identifier: MIT
 */

#include "corne.dtsi"

&kscan0 {
    col-gpios
        = <&pro_micro 21 GPIO_ACTIVE_HIGH>
        , <&pro_micro 20 GPIO_ACTIVE_HIGH>
        , <&pro_micro 19 GPIO_ACTIVE_HIGH>
        , <&pro_micro 16 GPIO_ACTIVE_HIGH>
        , <&pro_micro 10 GPIO_ACTIVE_HIGH>
        , <&pro_micro 14 GPIO_ACTIVE_HIGH>
        ;
	row-gpios
		= <&pro_micro 4 (GPIO_ACTIVE_LOW | GPIO_PULL_UP)>
		, <&pro_micro 0 (GPIO_ACTIVE_LOW | GPIO_PULL_UP)>
		, <&pro_micro 6 (GPIO_ACTIVE_LOW | GPIO_PULL_UP)>
		, <&pro_micro 7 (GPIO_ACTIVE_LOW | GPIO_PULL_UP)>
		;
};
