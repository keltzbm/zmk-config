#include "corne.dtsi"

&default_transform {
    col-offset = <6>;
};

&five_column_transform {
    col-offset = <6>;
};

&kscan0 {
    col-gpios
        = <&pro_micro 14 GPIO_OPEN_SOURCE>
        , <&pro_micro 15 GPIO_OPEN_SOURCE>
        , <&pro_micro 18 GPIO_OPEN_SOURCE>
        , <&pro_micro 19 GPIO_OPEN_SOURCE>
        , <&pro_micro 20 GPIO_OPEN_SOURCE>
        , <&pro_micro 21 GPIO_OPEN_SOURCE>
        ;
};
