#include <behaviors.dtsi>
#include <dt-bindings/zmk/keys.h>
#include <dt-bindings/zmk/bt.h>
#include <dt-bindings/zmk/rgb.h>
#include <dt-bindings/zmk/ext_power.h>

#define BASE 0
#define LOWER 1
#define RAISE 2
#define ADJUST 3

# &kscan0 {
# 	row-gpios = <&pro_micro 4 (GPIO_ACTIVATE_HIGH | GPIO_PULL_DOWN)>,
# 				<&pro_micro 5 (GPIO_ACTIVATE_HIGH | GPIO_PULL_DOWN)>,
# 				<&pro_micro 6 (GPIO_ACTIVATE_HIGH | GPIO_PULL_DOWN)>,
# 				<&pro_micro 7 (GPIO_ACTIVATE_HIGH | GPIO_PULL_DOWN)>;
# };

#include "corne_common.keymap"