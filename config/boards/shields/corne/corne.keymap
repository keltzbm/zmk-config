#include <behaviors.dtsi>
#include <dt-bindings/zmk/keys.h>
#include <dt-bindings/zmk/bt.h>

enum corne_layers {
	BASE,
	DATA,
	EDIT,
	SYMBOL,
	PROGRAM,
	UTILITY
};

// ┌───────┬───────┬───────┬───────┬───────┬───────┐       ┌───────┬───────┬───────┬───────┬───────┬───────┐
// │       │       │       │       │       │       │       │       │       │       │       │       │       │
// │       │       │       │       │       │       │       │       │       │       │       │       │       │
// ├───────┼───────┼───────┼───────┼───────┼───────┤       ├───────┼───────┼───────┼───────┼───────┼───────┤
// │       │       │       │       │       │       │       │       │       │       │       │       │       │
// │       │       │       │       │       │       │       │       │       │       │       │       │       │
// ├───────┼───────┼───────┼───────┼───────┼───────┤       ├───────┼───────┼───────┼───────┼───────┼───────┤
// │       │       │       │       │       │       │       │       │       │       │       │       │       │
// │       │       │       │       │       │       │       │       │       │       │       │       │       │
// └───────┴───────┴───────┼───────┼───────┼───────┤       ├───────┼───────┼───────┼───────┴───────┴───────┘
//                         │       │       │       │       │       │       │       │
//                         │       │       │       │       │       │       │       │
//                         └───────┴───────┴───────┘       └───────┴───────┴───────┘ 


/ {
    keymap {
        compatible = "zmk,keymap";
		base_layer {
			bindings = <
				&trans &kp Q &kp W &kp E     &kp R   &kp T       &kp Y    &kp U     &kp I     &kp O   &kp P     &trans
				&trans &kp A &kp S &kp D     &kp F   &kp G       &kp H    &kp J     &kp K     &kp L   &kp SEMI  &trans
				&trans &kp Z &kp X &kp C     &kp V   &kp B       &kp N    &kp M     &kp COMMA &kp DOT &kp SLASH &trans
						           &kp LCTRL &kp RET &kp TAB     &kp BSPC &kp SPACE &kp LSHFT
						           &lt UTILITY SPACE &lt DATA SPACE &lt DATA SPACE     &kp BSPC &kp SPACE &kp LSHFT
			>;
        };
        data_layer {
			bindings = <
				&trans &trans &trans &trans &trans &trans	&trans &trans &trans &trans &trans &trans
				&trans &trans &trans &trans &trans &trans	&trans &trans &trans &trans &trans &trans
				&trans &trans &trans &trans &trans &trans	&trans &trans &trans &trans &trans &trans
						             &trans &trans &trans	&trans &trans &trans
			>;
        };
        edit_layer {
			bindings = <
				&trans &trans &trans &trans &trans &trans	&trans &trans &trans &trans &trans &trans
				&trans &trans &trans &trans &trans &trans	&trans &trans &trans &trans &trans &trans
				&trans &trans &trans &trans &trans &trans	&trans &trans &trans &trans &trans &trans
						             &trans &trans &trans	&trans &trans &trans
			>;
        };
        symbol_layer {
			bindings = <
				&trans &trans &trans &trans &trans &trans	&trans &trans &trans &trans &trans &trans
				&trans &trans &trans &trans &trans &trans	&trans &trans &trans &trans &trans &trans
				&trans &trans &trans &trans &trans &trans	&trans &trans &trans &trans &trans &trans
						             &trans &trans &trans	&trans &trans &trans
			>;
        };
        program_layer {
			bindings = <
				&trans &trans &trans &trans &trans &trans	&trans &trans &trans &trans &trans &trans
				&trans &trans &trans &trans &trans &trans	&trans &trans &trans &trans &trans &trans
				&trans &trans &trans &trans &trans &trans	&trans &trans &trans &trans &trans &trans
						             &trans &trans &trans	&trans &trans &trans
			>;
        };
        utility_layer {
			bindings = <
				&trans &trans &trans &trans &trans &trans	&trans &trans &trans &trans &trans &trans
				&trans &trans &trans &trans &trans &trans	&trans &trans &trans &trans &trans &trans
				&trans &trans &trans &trans &trans &trans	&trans &trans &trans &trans &trans &trans
						             &trans &trans &trans	&trans &trans &trans
			>;
        };
        control_layer {
			bindings = <
				&trans &trans &trans &trans &trans &trans	&trans &trans &trans &trans &trans &trans
				&trans &trans &trans &trans &trans &trans	&trans &trans &trans &trans &trans &trans
				&trans &trans &trans &trans &trans &trans	&trans &trans &trans &trans &trans &trans
						             &trans &trans &trans	&trans &trans &trans
			>;
        };
        edit_layer {
			bindings = <
				&trans &trans &trans &trans &trans &trans	&trans &trans &trans &trans &trans &trans
				&trans &trans &trans &trans &trans &trans	&trans &trans &trans &trans &trans &trans
				&trans &trans &trans &trans &trans &trans	&trans &trans &trans &trans &trans &trans
						             &trans &trans &trans	&trans &trans &trans
			>;
        };
	};
};
