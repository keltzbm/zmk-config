/*
 * Copyright (c) 2020 Pete Johanson
 *
 * SPDX-License-Identifier: MIT
 */

#include "corne.dtsi"

&kscan0 {
    col-gpios
        = <&pro_micro 21 (GPIO_ACTIVE_LOW | GPIO_PULL_UP)>
        , <&pro_micro 20 (GPIO_ACTIVE_LOW | GPIO_PULL_UP)>
        , <&pro_micro 19 (GPIO_ACTIVE_LOW | GPIO_PULL_UP)>
        , <&pro_micro 18 (GPIO_ACTIVE_LOW | GPIO_PULL_UP)>
        , <&pro_micro 15 (GPIO_ACTIVE_LOW | GPIO_PULL_UP)>
        , <&pro_micro 14 (GPIO_ACTIVE_LOW | GPIO_PULL_UP)>
        ;
};
